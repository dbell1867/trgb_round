// Stage 5b2 — monster eye that looks around (motion tuned for 16 fps). Port of the renderer and motion
// logic from Adafruit's Uncanny Eyes (MIT license, Phil Burgess / Paint Your
// Dragon): dragon eye at 240x240, pixel-doubled into a 480x480 PSRAM frame.
// Random saccades (flick + hold) and a random-walk pupil; no eyelids yet.
#include <Arduino.h>
#include <LilyGo_RGBPanel.h>
#include "board_pins.h"
#include "eye_dragon.h"     // GENERATED by scripts/gen_eye.py (tables live in flash)

constexpr int W = 480, H = 480;            // panel
constexpr int S = SCREEN_SIZE;             // render size (240), doubled to W
static_assert(S * 2 == W, "render size must be half the panel size");

// Pupil size range for the dragon eye (from Adafruit's dragonEye.h).
constexpr int IRIS_MIN = 80, IRIS_MAX = 400;
constexpr uint16_t LID_COLOUR = 0x0000;    // eyelids: black, like the original

LilyGo_RGBPanel panel;
uint16_t *fb = nullptr;                    // 480x480 frame in PSRAM

// Render one frame into fb.
//   iScale  pupil size 0..1023 (bigger = wider pupil)
//   sx, sy  top-left offset into the sclera image, 0..SCLERA_SIZE-S (30 = centred)
//   uT, lT  upper/lower eyelid thresholds, 0 = open .. 254 = closed
void drawEye(int iScale, int sx, int sy, uint8_t uT, uint8_t lT) {
    const int irisThreshold = (128 * (1023 - iScale) + 512) / 1024;
    const uint32_t irisScale = IRIS_MAP_HEIGHT * 65536 / irisThreshold;
    const int irisOffset = (SCLERA_SIZE - IRIS_SIZE) / 2;   // iris centred in sclera

    for (int y = 0; y < S; y++) {
        const int scY = sy + y;
        const int irY = scY - irisOffset;
        // Two output pixels per rendered pixel: write them as one 32-bit word.
        uint32_t *out = reinterpret_cast<uint32_t *>(fb + (2 * y) * W);
        for (int x = 0; x < S; x++) {
            const int scX = sx + x;
            const int irX = scX - irisOffset;
            uint16_t p;
            if (lower[y][x] <= lT || upper[y][x] <= uT) {
                p = LID_COLOUR;                                   // under an eyelid
            } else if (irY < 0 || irY >= IRIS_SIZE || irX < 0 || irX >= IRIS_SIZE) {
                p = sclera[scY][scX];                             // outside the iris box
            } else {
                const uint16_t pol = polar[irY][irX];             // angle | distance
                uint32_t d = pol & 0x7F;                          // distance from iris edge
                if (d < (uint32_t)irisThreshold) {                // inside the (scaled) iris
                    d = d * irisScale / 65536;                    // -> iris texture row
                    const int a = (IRIS_MAP_WIDTH * (pol >> 7)) / 512;   // -> texture column
                    p = iris[d][a];
                } else {
                    p = sclera[scY][scX];                         // pupil: sclera shows through
                }
            }
            out[x] = (uint32_t)p << 16 | p;                       // pixel doubled horizontally
        }
        // ...and vertically: copy the finished row to the one below.
        memcpy(fb + (2 * y + 1) * W, fb + (2 * y) * W, W * sizeof(uint16_t));
    }
}

// Print only if the whole line fits in the USB transmit buffer; otherwise drop it.
// Core 2.0.17's HWCDC::write() can wait forever when the cable is plugged in but
// no program has the port open (see lesson 05) — this never reaches that path.
void logf(const char *fmt, ...) {
    char buf[200];
    va_list args;
    va_start(args, fmt);
    int n = vsnprintf(buf, sizeof(buf), fmt, args);
    va_end(args);
    if (n > 0 && Serial.availableForWrite() >= n) Serial.write(buf, n);
}

// ---- Eye motion (saccades) -------------------------------------------------
// Positions are 0..1023 on each axis (512 = centre), like the original; mapped
// to a sclera offset 0..SCLERA_SIZE-S when drawing. Tuned for a 16 fps display
// (stage 5b2): mostly small glances, flick time grows with distance so big
// looks get more frames, and a slow sub-pixel drift while holding.
struct Saccade {
    static constexpr int SMALL_HOP = 160;       // radius of a "glance", 0..1023 units
    static constexpr int BIG_LOOK_PERCENT = 20; // chance of a look anywhere instead
    bool moving = false;
    int oldX = 512, oldY = 512, newX = 512, newY = 512;
    uint32_t start = 0, duration = 0;           // microseconds
    uint32_t small = 0, big = 0, flickUsSum = 0;   // stats for the log

    // Smooth start and stop: smoothstep 3t^2 - 2t^3, t in 0..1 -> 0..1.
    static float ease(float t) { return t * t * (3 - 2 * t); }
    static bool inCircle(int x, int y) {
        int dx = x * 2 - 1023, dy = y * 2 - 1023;
        return dx * dx + dy * dy <= 1023 * 1023;
    }

    void pickTarget() {
        if (random(100) < BIG_LOOK_PERCENT) {   // big look: anywhere in the circle
            do { newX = random(1024); newY = random(1024); } while (!inCircle(newX, newY));
            big++;
        } else {                                 // glance: a short hop from here
            do {
                newX = oldX + random(-SMALL_HOP, SMALL_HOP + 1);
                newY = oldY + random(-SMALL_HOP, SMALL_HOP + 1);
            } while (newX < 0 || newX > 1023 || newY < 0 || newY > 1023 || !inCircle(newX, newY));
            small++;
        }
        // Real eyes take longer for bigger moves ("main sequence"). Stretched for
        // 16 fps: ~110 ms for a tiny hop up to ~400 ms across the whole eye.
        float dist = hypotf(newX - oldX, newY - oldY);           // 0 .. ~1450
        duration = (100000 + dist * 200) * random(85, 116) / 100;
        flickUsSum += duration;
    }

    void update(uint32_t now, int &x, int &y) {
        uint32_t dt = now - start;
        if (moving) {
            if (dt >= duration) {               // arrived: hold for 0.2-3 s
                moving = false;
                oldX = newX; oldY = newY;
                duration = random(200000, 3000000);
                start = now;
                x = oldX; y = oldY;
            } else {                            // in flight: interpolate
                float e = ease((float)dt / duration);
                x = oldX + (newX - oldX) * e;
                y = oldY + (newY - oldY) * e;
            }
        } else {
            x = oldX; y = oldY;
            if (dt >= duration) {               // hold over: start a new flick
                pickTarget();
                start = now;
                moving = true;
            }
        }
        // Drift: two slow, unrelated sine waves per axis, about +-25 units
        // (~1.5 rendered px, ~3 screen px), so the eye is never perfectly still.
        float ts = now / 1e6f;
        x = constrain(x + (int)(15 * sinf(ts * 1.3f) + 10 * sinf(ts * 0.47f + 1.0f)), 0, 1023);
        y = constrain(y + (int)(15 * sinf(ts * 1.1f + 2.0f) + 10 * sinf(ts * 0.61f)), 0, 1023);
    }
};

// ---- Pupil (random walk) ---------------------------------------------------
// Adafruit's split(): every 10 s pick a new pupil size, then recursively displace
// the midpoint by a random amount, halving the range each level, until the range
// is < 8. The original draws frames inside the recursion (blocking); here the
// recursion just fills a list of keyframes and loop() interpolates by time.
struct PupilWalk {
    static constexpr uint32_t SEGMENT_US = 10000000;   // 10 s per target
    static constexpr int MAX_KEYS = 66;                // 2^6 segments + ends, plenty
    int16_t value[MAX_KEYS];
    uint32_t when[MAX_KEYS];
    int count = 0;
    int current = (IRIS_MIN + IRIS_MAX) / 2;
    uint32_t segStart = 0;

    void split(int startV, int endV, uint32_t startT, uint32_t dur, int range) {
        if (range >= 8 && count < MAX_KEYS - 1) {
            range /= 2; dur /= 2;
            int midV = (startV + endV - range) / 2 + random(range);
            split(startV, midV, startT, dur, range);
            split(midV, endV, startT + dur, dur, range);
        } else {                                       // leaf: record its end point
            value[count] = endV; when[count] = startT + dur - segStart; count++;
        }
    }
    void newSegment(uint32_t now) {
        int target = random(IRIS_MIN, IRIS_MAX);
        segStart = now; count = 0;
        value[count] = current; when[count] = 0; count++;   // starts where we are
        split(current, target, now, SEGMENT_US, IRIS_MAX - IRIS_MIN);
    }
    int update(uint32_t now) {
        uint32_t dt = now - segStart;
        if (count == 0 || dt >= SEGMENT_US) { newSegment(now); dt = 0; }
        int i = 1;
        while (i < count - 1 && when[i] <= dt) i++;   // first keyframe after dt
        uint32_t t0 = when[i - 1], t1 = when[i];
        int v = value[i - 1] + (int)((value[i] - value[i - 1]) * (int64_t)(dt - t0) / (int64_t)(t1 - t0));
        current = constrain(v, IRIS_MIN, IRIS_MAX);
        return current;
    }
};

Saccade saccade;
PupilWalk pupil;

void setup() {
    Serial.begin(115200);
    Serial.setTxTimeoutMs(0);   // G11 — not enough on core 2.0.17, hence logf()
    delay(1500);
    Serial.println("\n=== T-RGB stage 5b2: monster eye, natural motion ===");
    Serial.printf("tables: screen %d, sclera %d, iris %d, iris map %dx%d\n",
                  SCREEN_SIZE, SCLERA_SIZE, IRIS_SIZE, IRIS_MAP_WIDTH, IRIS_MAP_HEIGHT);

    panel.begin();
    fb = (uint16_t *)ps_malloc(W * H * sizeof(uint16_t));
    if (!fb) { Serial.println("ps_malloc failed"); return; }

    drawEye((IRIS_MIN + IRIS_MAX) / 2, (SCLERA_SIZE - S) / 2, (SCLERA_SIZE - S) / 2, 0, 0);
    panel.pushColors(0, 0, W, H, fb);          // END coords — full frame
    panel.setBrightness(16);                   // after drawing (G21)
}

void loop() {
    static uint32_t totalFrames = 0, frames = 0, renderUs = 0, pushUs = 0, lastReport = millis();

    static uint32_t moves = 0;
    const uint32_t now = micros();
    int ex, ey;
    const bool wasMoving = saccade.moving;
    saccade.update(now, ex, ey);
    if (saccade.moving && !wasMoving) moves++;
    const int iScale = pupil.update(now);

    // 0..1023 -> sclera offset 0..SCLERA_SIZE-S (like Arduino's map()).
    const int sx = ex * (SCLERA_SIZE - S) / 1023;
    const int sy = ey * (SCLERA_SIZE - S) / 1023;

    uint32_t t0 = micros();
    drawEye(iScale, sx, sy, 0, 0);
    uint32_t t1 = micros();
    panel.pushColors(0, 0, W, H, fb);
    uint32_t t2 = micros();

    frames++;
    renderUs += t1 - t0;
    pushUs += t2 - t1;
    if (millis() - lastReport >= 2000) {
        totalFrames += frames;
        logf("t=%3lus  frames %lu  %.1f fps  render+double %lu us  push %lu us  "
             "iScale %d  offset %d,%d  glances %lu big %lu  mean flick %lu ms\n",
             millis() / 1000, (unsigned long)totalFrames,
             frames * 1000.0f / (millis() - lastReport),
             (unsigned long)(renderUs / frames), (unsigned long)(pushUs / frames),
             iScale, sx, sy, (unsigned long)saccade.small, (unsigned long)saccade.big,
             (unsigned long)(moves ? saccade.flickUsSum / moves / 1000 : 0));
        frames = renderUs = pushUs = 0;
        lastReport = millis();
    }
}
