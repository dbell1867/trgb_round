// Stage 5d — monster eye that feels pain. Port of the renderer and motion
// logic from Adafruit's Uncanny Eyes (MIT license, Phil Burgess / Paint Your
// Dragon): dragon eye at 240x240, pixel-doubled into a 480x480 PSRAM frame.
// Random saccades, random-walk pupil, lids that track and blink — and a touch
// makes it flinch shut, squint and tremble with a red, pinpoint-pupilled iris.
// Stage 6a: pumpkin-flesh eyelids (textured by depth into the lid) + lid shadow.
#include <Arduino.h>
#include <LilyGo_RGBPanel.h>
#include "board_pins.h"
#include "eye_dragon.h"     // GENERATED by scripts/gen_eye.py (tables live in flash)
#include "lid_pumpkin.h"    // GENERATED by scripts/gen_lids.py: lidTex[depth][x]

constexpr int W = 480, H = 480;            // panel
constexpr int S = SCREEN_SIZE;             // render size (240), doubled to W
static_assert(S * 2 == W, "render size must be half the panel size");

// Pupil size range for the dragon eye (from Adafruit's dragonEye.h).
constexpr int IRIS_MIN = 80, IRIS_MAX = 400;
constexpr uint16_t PAIN_RED = 0xF800;      // iris tint while in pain

LilyGo_RGBPanel panel;
uint16_t *fb = nullptr;                    // the frame drawEye() renders into
uint16_t *fbs[2] = {nullptr, nullptr};     // two 480x480 frames in PSRAM (stage 7)
// Lid texture, copied from flash into internal RAM at startup (flash reads go
// through a small cache; the per-pixel tables kept evicting each other).
// Pointer-to-row type, so lid[depth][x] works exactly like the flash table.
const uint16_t (*lid)[SCREEN_SIZE] = lidTex;
// Eyelid threshold maps, read for every pixel: same trick.
const uint8_t (*upMap)[SCREEN_SIZE] = upper;
const uint8_t (*loMap)[SCREEN_SIZE] = lower;

// Render one frame into fb.
//   iScale  pupil size 0..1023 (bigger = wider pupil)
//   sx, sy  top-left offset into the sclera image, 0..SCLERA_SIZE-S (30 = centred)
//   uT, lT  upper/lower eyelid thresholds, 0 = open .. 254 = closed
//   tint    0..32, how far the iris is blended towards PAIN_RED

// Blend two RGB565 colours, alpha 0..32. Spreading the 5-6-5 fields apart in a
// 32-bit word (G..R..B with gaps) lets one multiply blend all three channels.
static inline uint16_t blend565(uint16_t fg, uint16_t bg, uint32_t alpha) {
    uint32_t f = (fg | (uint32_t)fg << 16) & 0x07E0F81F;
    uint32_t b = (bg | (uint32_t)bg << 16) & 0x07E0F81F;
    uint32_t r = (b + (((f - b) * alpha) >> 5)) & 0x07E0F81F;
    return r | r >> 16;
}

void drawEye(int iScale, int sx, int sy, uint8_t uT, uint8_t lT, uint8_t tint) {
    const int irisThreshold = (128 * (1023 - iScale) + 512) / 1024;
    const uint32_t irisScale = IRIS_MAP_HEIGHT * 65536 / irisThreshold;
    const int irisOffset = (SCLERA_SIZE - IRIS_SIZE) / 2;   // iris centred in sclera

    for (int y = 0; y < S; y++) {
        const int scY = sy + y;
        const int irY = scY - irisOffset;
        // Two output pixels per rendered pixel: write them as one 32-bit word.
        uint32_t *out = reinterpret_cast<uint32_t *>(fb + (2 * y) * W);
        uint32_t *out2 = out + W / 2;             // the row below (W/2 words per row)
        for (int x = 0; x < S; x++) {
            const int scX = sx + x;
            const int irX = scX - irisOffset;
            // How far inside each lid this pixel is (>= 0 = covered by that lid).
            const int du = uT - upMap[y][x], dl = lT - loMap[y][x];
            uint16_t p;
            if (du >= 0 || dl >= 0) {
                // Pumpkin texture by depth from the nearest covering edge, so the
                // glowing cut edge always rides on the lid's moving edge.
                const int depth = (du >= 0 && dl >= 0) ? min(du, dl) : max(du, dl);
                const uint16_t c = lid[depth][x];
                out[x] = out2[x] = (uint32_t)c << 16 | c;
                continue;
            } else if (irY < 0 || irY >= IRIS_SIZE || irX < 0 || irX >= IRIS_SIZE) {
                p = sclera[scY][scX];                             // outside the iris box
            } else {
                const uint16_t pol = polar[irY][irX];             // angle | distance
                uint32_t d = pol & 0x7F;                          // distance from iris edge
                if (d < (uint32_t)irisThreshold) {                // inside the (scaled) iris
                    d = d * irisScale / 65536;                    // -> iris texture row
                    const int a = (IRIS_MAP_WIDTH * (pol >> 7)) / 512;   // -> texture column
                    p = iris[d][a];
                    if (tint) p = blend565(PAIN_RED, p, tint);
                } else {
                    p = sclera[scY][scX];                         // pupil: sclera shows through
                }
            }
            // Shadow cast by the nearer lid edge, darkest right under it.
            const int gap = min(-du, -dl);                        // > 0: distance to edge
            if (gap <= LID_SHADOW)
                p = blend565(0x0000, p, LID_SHADOW_MAX * (LID_SHADOW + 1 - gap) / LID_SHADOW);
            out[x] = out2[x] = (uint32_t)p << 16 | p;             // doubled across and down
        }
    }
}

// Print only if the whole line fits in the USB transmit buffer; otherwise drop it.
// Core 2.0.17's HWCDC::write() can wait forever when the cable is plugged in but
// no program has the port open (see lesson 05) — this never reaches that path.
void logf(const char *fmt, ...) {
    char buf[200];
    va_list args;
    va_start(args, fmt);
    int n = vsnprintf(buf, sizeof(buf), fmt, args);
    va_end(args);
    if (n > 0 && Serial.availableForWrite() >= n) Serial.write(buf, n);
}

// ---- Eye motion (saccades) -------------------------------------------------
// Positions are 0..1023 on each axis (512 = centre), like the original; mapped
// to a sclera offset 0..SCLERA_SIZE-S when drawing. Tuned for a 16 fps display
// (stage 5b2): mostly small glances, flick time grows with distance so big
// looks get more frames, and a slow sub-pixel drift while holding.
struct Saccade {
    static constexpr int SMALL_HOP = 160;       // radius of a "glance", 0..1023 units
    static constexpr int BIG_LOOK_PERCENT = 20; // chance of a look anywhere instead
    bool moving = false;
    int oldX = 512, oldY = 512, newX = 512, newY = 512;
    uint32_t start = 0, duration = 0;           // microseconds
    uint32_t small = 0, big = 0, flickUsSum = 0;   // stats for the log

    // Smooth start and stop: smoothstep 3t^2 - 2t^3, t in 0..1 -> 0..1.
    static float ease(float t) { return t * t * (3 - 2 * t); }
    static bool inCircle(int x, int y) {
        int dx = x * 2 - 1023, dy = y * 2 - 1023;
        return dx * dx + dy * dy <= 1023 * 1023;
    }

    void pickTarget() {
        if (random(100) < BIG_LOOK_PERCENT) {   // big look: anywhere in the circle
            do { newX = random(1024); newY = random(1024); } while (!inCircle(newX, newY));
            big++;
        } else {                                 // glance: a short hop from here
            do {
                newX = oldX + random(-SMALL_HOP, SMALL_HOP + 1);
                newY = oldY + random(-SMALL_HOP, SMALL_HOP + 1);
            } while (newX < 0 || newX > 1023 || newY < 0 || newY > 1023 || !inCircle(newX, newY));
            small++;
        }
        // Real eyes take longer for bigger moves ("main sequence"). Stretched for
        // 16 fps: ~110 ms for a tiny hop up to ~400 ms across the whole eye.
        float dist = hypotf(newX - oldX, newY - oldY);           // 0 .. ~1450
        duration = (100000 + dist * 200) * random(85, 116) / 100;
        flickUsSum += duration;
    }

    void update(uint32_t now, int &x, int &y) {
        uint32_t dt = now - start;
        if (moving) {
            if (dt >= duration) {               // arrived: hold for 0.2-3 s
                moving = false;
                oldX = newX; oldY = newY;
                duration = random(200000, 3000000);
                start = now;
                x = oldX; y = oldY;
            } else {                            // in flight: interpolate
                float e = ease((float)dt / duration);
                x = oldX + (newX - oldX) * e;
                y = oldY + (newY - oldY) * e;
            }
        } else {
            x = oldX; y = oldY;
            if (dt >= duration) {               // hold over: start a new flick
                pickTarget();
                start = now;
                moving = true;
            }
        }
        // Drift: two slow, unrelated sine waves per axis, about +-25 units
        // (~1.5 rendered px, ~3 screen px), so the eye is never perfectly still.
        float ts = now / 1e6f;
        x = constrain(x + (int)(15 * sinf(ts * 1.3f) + 10 * sinf(ts * 0.47f + 1.0f)), 0, 1023);
        y = constrain(y + (int)(15 * sinf(ts * 1.1f + 2.0f) + 10 * sinf(ts * 0.61f)), 0, 1023);
    }
};

// ---- Pupil (random walk) ---------------------------------------------------
// Adafruit's split(): every 10 s pick a new pupil size, then recursively displace
// the midpoint by a random amount, halving the range each level, until the range
// is < 8. The original draws frames inside the recursion (blocking); here the
// recursion just fills a list of keyframes and loop() interpolates by time.
struct PupilWalk {
    static constexpr uint32_t SEGMENT_US = 10000000;   // 10 s per target
    static constexpr int MAX_KEYS = 66;                // 2^6 segments + ends, plenty
    int16_t value[MAX_KEYS];
    uint32_t when[MAX_KEYS];
    int count = 0;
    int current = (IRIS_MIN + IRIS_MAX) / 2;
    uint32_t segStart = 0;

    void split(int startV, int endV, uint32_t startT, uint32_t dur, int range) {
        if (range >= 8 && count < MAX_KEYS - 1) {
            range /= 2; dur /= 2;
            int midV = (startV + endV - range) / 2 + random(range);
            split(startV, midV, startT, dur, range);
            split(midV, endV, startT + dur, dur, range);
        } else {                                       // leaf: record its end point
            value[count] = endV; when[count] = startT + dur - segStart; count++;
        }
    }
    void newSegment(uint32_t now) {
        int target = random(IRIS_MIN, IRIS_MAX);
        segStart = now; count = 0;
        value[count] = current; when[count] = 0; count++;   // starts where we are
        split(current, target, now, SEGMENT_US, IRIS_MAX - IRIS_MIN);
    }
    int update(uint32_t now) {
        uint32_t dt = now - segStart;
        if (count == 0 || dt >= SEGMENT_US) { newSegment(now); dt = 0; }
        int i = 1;
        while (i < count - 1 && when[i] <= dt) i++;   // first keyframe after dt
        uint32_t t0 = when[i - 1], t1 = when[i];
        int v = value[i - 1] + (int)((value[i] - value[i - 1]) * (int64_t)(dt - t0) / (int64_t)(t1 - t0));
        current = constrain(v, IRIS_MIN, IRIS_MAX);
        return current;
    }
};

// ---- Eyelids: tracking + blinks ---------------------------------------------
// Upper lid follows the pupil by sampling the upper-lid threshold map just above
// it; the lower lid is "pulled up by tension" from the upper. Blinks blend both
// thresholds towards 254 (shut): close in 100-150 ms, reopen at half speed.
// (The original closes in 36-72 ms — 0-1 frames at our 18 fps, which reads as a
// black flash. 100-150 ms is also closer to a real human blink.)
struct Lids {
    enum State { OPEN, CLOSING, OPENING };
    State state = OPEN;
    uint32_t start = 0, duration = 0;          // current blink phase
    uint32_t lastBlink = 0, nextBlink = 1000000;
    uint8_t uFiltered = 128;
    uint32_t blinks = 0;

    void startBlink(uint32_t now, uint32_t closeUs) {
        state = CLOSING; start = now; duration = closeUs; blinks++;
    }

    // sx, sy = sclera offset used for this frame; extraClosure = 0..1 from pain.
    // Returns thresholds via uT/lT.
    void update(uint32_t now, int sx, int sy, float extraClosure, uint8_t &uT, uint8_t &lT) {
        // Autonomous blinks.
        if (now - lastBlink >= nextBlink) {
            uint32_t d = random(100000, 150000);
            lastBlink = now;
            nextBlink = d * 3 + random(4000000);
            if (state == OPEN) startBlink(now, d);
        }
        if (state != OPEN && now - start >= duration) {
            if (state == CLOSING) { state = OPENING; start = now; duration *= 2; }
            else state = OPEN;
        }

        // Tracking: sample the upper map a quarter iris above the pupil centre,
        // averaged with the mirror-image point (the lid art isn't quite symmetric).
        const int sampleX = SCLERA_SIZE / 2 - sx / 2;               // reduce X influence
        const int sampleY = SCLERA_SIZE / 2 - (sy + IRIS_SIZE / 4);
        uint8_t n = 0;
        if (sampleY >= 0)
            n = (upper[sampleY][sampleX] + upper[sampleY][S - 1 - sampleX]) / 2;
        uFiltered = (uFiltered * 3 + n) / 4;                        // soften motion

        // Closure 0 (as tracked) .. 1 (shut): the larger of blink and pain.
        float closure = 0;
        if (state != OPEN) {
            float f = min(1.0f, (float)(now - start) / duration);    // 0..1 through phase
            closure = (state == CLOSING) ? f : 1 - f;
        }
        closure = max(closure, extraClosure);
        uT = uFiltered + (254 - uFiltered) * closure;
        lT = (254 - uFiltered) + uFiltered * closure;                // = 254 - u, then towards 254
    }
};

// ---- Pain ------------------------------------------------------------------
// A touch sets the clock back to zero. Everything derives from time-since-touch:
//   0-0.4 s  flinch: lids slam shut (in 60 ms — a flinch should snap)
//   0.4-3 s  squint (lids ~60 % shut) with flutter blinks, pinpoint pupil,
//            trembling, red iris
//   3-5 s    recovery: level 1 -> 0, everything eases back to normal
struct Pain {
    static constexpr uint32_t FLINCH_US = 400000, HURT_US = 3000000, RECOVER_US = 2000000;
    static constexpr float SQUINT = 0.6f;
    bool active = false;
    uint32_t since = 0;                       // time of last touch
    uint32_t flutterStart = 0, nextFlutter = 0;
    uint32_t touches = 0;

    void hurt(uint32_t now) {
        if (!active) touches++;
        active = true; since = now; nextFlutter = FLINCH_US;
    }
    // 1 while hurting, falling to 0 over the recovery.
    float level(uint32_t now) {
        if (!active) return 0;
        uint32_t t = now - since;
        if (t < HURT_US) return 1;
        if (t < HURT_US + RECOVER_US) return 1 - (float)(t - HURT_US) / RECOVER_US;
        active = false;
        return 0;
    }
    // Extra lid closure 0..1.
    float closure(uint32_t now) {
        if (!active) return 0;
        uint32_t t = now - since;
        if (t < 60000) return t / 60000.0f;                  // slam shut
        if (t < FLINCH_US) return 1;                         // hold shut
        if (t < HURT_US) {                                   // squint + flutter
            if (t >= nextFlutter) {
                flutterStart = t;
                nextFlutter = t + random(250000, 450000);
            }
            float f = (t - flutterStart) / 150000.0f;        // 150 ms dip: shut and back
            float flutter = f < 1 ? 1 - fabsf(2 * f - 1) : 0;
            return max(SQUINT, flutter);
        }
        return SQUINT * level(now);                          // recovering
    }
};

// ---- Touch (stage 3b "LEVEL mode") ---------------------------------------------
// GT911 INT is LOW while a finger is down OR a report is waiting (latched until
// read), so: read only while INT is LOW, plus one read after it rises. A short
// tap between two frames is still caught — the report waits for us.
bool touched() {
    static bool wasLow = false;
    bool intLow = digitalRead(pins::TOUCH_IRQ) == LOW;
    bool doRead = intLow || wasLow;
    wasLow = intLow;
    if (!doRead) return false;
    int16_t xs[5], ys[5];                       // SensorLib GT911: always 5 (stage 3a)
    return panel.getPoint(xs, ys, 5) > 0;
}

Saccade saccade;
PupilWalk pupil;
Lids lids;
Pain pain;

// ---- Two-core pipeline (stage 7) ---------------------------------------------
// Core 1 (loop) renders frame N+1 while core 0 (pushTask) pushes frame N.
// Buffers travel through two queues, so neither core touches a buffer the
// other is using:  freeQ  = buffers ready to draw into (pusher -> renderer)
//                  readyQ = finished frames to push   (renderer -> pusher)
QueueHandle_t freeQ, readyQ;

// Pusher statistics: only pushTask writes them, only ever increasing; loop()
// reads them and takes differences, so the two cores never write the same word.
volatile uint32_t pushCount = 0, pushBusyUs = 0, pushWaitUs = 0;

void pushTask(void *) {
    for (;;) {
        uint16_t *buf;
        uint32_t t0 = micros();
        xQueueReceive(readyQ, &buf, portMAX_DELAY);    // wait for a finished frame
        uint32_t t1 = micros();
        panel.pushColors(0, 0, W, H, buf);
        uint32_t t2 = micros();
        xQueueSend(freeQ, &buf, portMAX_DELAY);        // hand the buffer back
        // Push is the bottleneck, so a frame is always waiting and this task never
        // blocks: IDLE0 starved and the task watchdog rebooted the chip every ~10 s.
        // Sleep one tick so IDLE0 runs. (Priority 0 instead halved push speed:
        // idle sleeps until the next tick each time it gets a turn.)
        vTaskDelay(1);
        pushWaitUs += t1 - t0;
        pushBusyUs += t2 - t1;
        pushCount++;
    }
}

void setup() {
    Serial.begin(115200);
    Serial.setTxTimeoutMs(0);   // G11 — not enough on core 2.0.17, hence logf()
    delay(1500);
    Serial.println("\n=== T-RGB stage 7: two-core render/push pipeline ===");
    Serial.printf("tables: screen %d, sclera %d, iris %d, iris map %dx%d\n",
                  SCREEN_SIZE, SCLERA_SIZE, IRIS_SIZE, IRIS_MAP_WIDTH, IRIS_MAP_HEIGHT);

    panel.begin();
    for (auto &b : fbs) {
        b = (uint16_t *)ps_malloc(W * H * sizeof(uint16_t));
        if (!b) { Serial.println("ps_malloc failed"); return; }
    }
    fb = fbs[0];
    // Copy the per-pixel tables from flash into internal RAM.
    constexpr uint32_t CAPS = MALLOC_CAP_INTERNAL | MALLOC_CAP_8BIT;
    auto *texRam = (uint16_t (*)[SCREEN_SIZE])heap_caps_malloc(sizeof(lidTex), CAPS);
    auto *upRam = (uint8_t (*)[SCREEN_SIZE])heap_caps_malloc(sizeof(upper), CAPS);
    auto *loRam = (uint8_t (*)[SCREEN_SIZE])heap_caps_malloc(sizeof(lower), CAPS);
    if (texRam) memcpy(texRam, lidTex, sizeof(lidTex));
    if (upRam) memcpy(upRam, upper, sizeof(upper));
    if (loRam) memcpy(loRam, lower, sizeof(lower));
    Serial.printf("RAM copies: texture %s, lid maps %s; internal RAM free %u\n",
                  texRam ? "ok" : "FAILED", upRam && loRam ? "ok" : "FAILED",
                  (unsigned)heap_caps_get_free_size(MALLOC_CAP_INTERNAL));

    // Use the RAM copies (stage 6b benchmark, same frame: all flash 41.2 ms,
    // + texture in RAM 34.5 ms, + lid maps in RAM 29.4 ms per render).
    if (texRam) lid = texRam;
    if (upRam && loRam) { upMap = upRam; loMap = loRam; }

    drawEye((IRIS_MIN + IRIS_MAX) / 2, (SCLERA_SIZE - S) / 2, (SCLERA_SIZE - S) / 2, 0, 0, 0);
    panel.pushColors(0, 0, W, H, fb);          // END coords — full frame
    panel.setBrightness(16);                   // after drawing (G21)

    // Start the pipeline: both buffers free, pusher on core 0 (loop runs on core 1).
    freeQ = xQueueCreate(2, sizeof(uint16_t *));
    readyQ = xQueueCreate(2, sizeof(uint16_t *));
    for (auto b : fbs) xQueueSend(freeQ, &b, 0);
    xTaskCreatePinnedToCore(pushTask, "push", 4096, nullptr, 2, nullptr, 0);
}

void loop() {
    static uint32_t totalFrames = 0, frames = 0, renderUs = 0, waitUs = 0, lastReport = millis();
    static uint32_t lastPushCount = 0, lastPushBusy = 0, lastPushWait = 0;

    static uint32_t moves = 0;
    const uint32_t now = micros();
    int ex, ey;
    const bool wasMoving = saccade.moving;
    saccade.update(now, ex, ey);
    if (saccade.moving && !wasMoving) moves++;
    if (touched()) pain.hurt(now);
    const float hurt = pain.level(now);        // 0 = calm .. 1 = in pain

    // Pupil shrinks to a pinpoint in pain (below IRIS_MIN = narrower than normal).
    constexpr int PINPOINT = 30;
    const int walk = pupil.update(now);
    const int iScale = walk + (PINPOINT - walk) * hurt;

    // 0..1023 -> sclera offset 0..SCLERA_SIZE-S (like Arduino's map()),
    // plus a tremble of up to +-6 rendered px while hurting.
    constexpr int MAX_OFS = SCLERA_SIZE - S;
    const int shake = 6 * hurt;
    int sx = ex * MAX_OFS / 1023, sy = ey * MAX_OFS / 1023;
    if (shake) {
        sx = constrain(sx + (int)random(-shake, shake + 1), 0, MAX_OFS);
        sy = constrain(sy + (int)random(-shake, shake + 1), 0, MAX_OFS);
    }

    uint8_t uT, lT;
    lids.update(now, sx, sy, pain.closure(now), uT, lT);
    const uint8_t tint = 20 * hurt;            // up to 20/32 of the way to red

    uint32_t t0 = micros();
    xQueueReceive(freeQ, &fb, portMAX_DELAY);  // a buffer the pusher is done with
    uint32_t t1 = micros();
    drawEye(iScale, sx, sy, uT, lT, tint);
    uint32_t t2 = micros();
    xQueueSend(readyQ, &fb, portMAX_DELAY);    // off to core 0

    frames++;
    waitUs += t1 - t0;
    renderUs += t2 - t1;
    if (millis() - lastReport >= 2000) {
        totalFrames += frames;
        const uint32_t pc = pushCount, pb = pushBusyUs, pw = pushWaitUs;   // snapshot
        const uint32_t pushes = max(1u, pc - lastPushCount);
        logf("t=%3lus  %.1f fps  render %lu us (waited %lu)  push %lu us (waited %lu)  "
             "pushes %lu  u %d l %d  touches %lu  hurt %.2f\n",
             millis() / 1000, frames * 1000.0f / (millis() - lastReport),
             (unsigned long)(renderUs / frames), (unsigned long)(waitUs / frames),
             (unsigned long)((pb - lastPushBusy) / pushes), (unsigned long)((pw - lastPushWait) / pushes),
             (unsigned long)pushes, uT, lT, (unsigned long)pain.touches, hurt);
        lastPushCount = pc; lastPushBusy = pb; lastPushWait = pw;
        frames = renderUs = waitUs = 0;
        lastReport = millis();
    }
}
