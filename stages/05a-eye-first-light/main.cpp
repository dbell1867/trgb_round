// Stage 5a — monster eye, first light. Port of the renderer from Adafruit's
// Uncanny Eyes (MIT license, Phil Burgess / Paint Your Dragon), drawing the
// dragon eye at 240x240 and pixel-doubling into a 480x480 PSRAM frame.
// The eye holds still while the pupil "breathes" so we can check the art.
#include <Arduino.h>
#include <LilyGo_RGBPanel.h>
#include "board_pins.h"
#include "eye_dragon.h"     // GENERATED by scripts/gen_eye.py (tables live in flash)

constexpr int W = 480, H = 480;            // panel
constexpr int S = SCREEN_SIZE;             // render size (240), doubled to W
static_assert(S * 2 == W, "render size must be half the panel size");

// Pupil size range for the dragon eye (from Adafruit's dragonEye.h).
constexpr int IRIS_MIN = 80, IRIS_MAX = 400;
constexpr uint16_t LID_COLOUR = 0x0000;    // eyelids: black, like the original

LilyGo_RGBPanel panel;
uint16_t *fb = nullptr;                    // 480x480 frame in PSRAM

// Render one frame into fb.
//   iScale  pupil size 0..1023 (bigger = wider pupil)
//   sx, sy  top-left offset into the sclera image, 0..SCLERA_SIZE-S (30 = centred)
//   uT, lT  upper/lower eyelid thresholds, 0 = open .. 254 = closed
void drawEye(int iScale, int sx, int sy, uint8_t uT, uint8_t lT) {
    const int irisThreshold = (128 * (1023 - iScale) + 512) / 1024;
    const uint32_t irisScale = IRIS_MAP_HEIGHT * 65536 / irisThreshold;
    const int irisOffset = (SCLERA_SIZE - IRIS_SIZE) / 2;   // iris centred in sclera

    for (int y = 0; y < S; y++) {
        const int scY = sy + y;
        const int irY = scY - irisOffset;
        // Two output pixels per rendered pixel: write them as one 32-bit word.
        uint32_t *out = reinterpret_cast<uint32_t *>(fb + (2 * y) * W);
        for (int x = 0; x < S; x++) {
            const int scX = sx + x;
            const int irX = scX - irisOffset;
            uint16_t p;
            if (lower[y][x] <= lT || upper[y][x] <= uT) {
                p = LID_COLOUR;                                   // under an eyelid
            } else if (irY < 0 || irY >= IRIS_SIZE || irX < 0 || irX >= IRIS_SIZE) {
                p = sclera[scY][scX];                             // outside the iris box
            } else {
                const uint16_t pol = polar[irY][irX];             // angle | distance
                uint32_t d = pol & 0x7F;                          // distance from iris edge
                if (d < (uint32_t)irisThreshold) {                // inside the (scaled) iris
                    d = d * irisScale / 65536;                    // -> iris texture row
                    const int a = (IRIS_MAP_WIDTH * (pol >> 7)) / 512;   // -> texture column
                    p = iris[d][a];
                } else {
                    p = sclera[scY][scX];                         // pupil: sclera shows through
                }
            }
            out[x] = (uint32_t)p << 16 | p;                       // pixel doubled horizontally
        }
        // ...and vertically: copy the finished row to the one below.
        memcpy(fb + (2 * y + 1) * W, fb + (2 * y) * W, W * sizeof(uint16_t));
    }
}

// Print only if the whole line fits in the USB transmit buffer; otherwise drop it.
// Core 2.0.17's HWCDC::write() can wait forever when the cable is plugged in but
// no program has the port open (see lesson 05) — this never reaches that path.
void logf(const char *fmt, ...) {
    char buf[200];
    va_list args;
    va_start(args, fmt);
    int n = vsnprintf(buf, sizeof(buf), fmt, args);
    va_end(args);
    if (n > 0 && Serial.availableForWrite() >= n) Serial.write(buf, n);
}

void setup() {
    Serial.begin(115200);
    Serial.setTxTimeoutMs(0);   // G11 — not enough on core 2.0.17, hence logf()
    delay(1500);
    Serial.println("\n=== T-RGB stage 5a: monster eye, first light ===");
    Serial.printf("tables: screen %d, sclera %d, iris %d, iris map %dx%d\n",
                  SCREEN_SIZE, SCLERA_SIZE, IRIS_SIZE, IRIS_MAP_WIDTH, IRIS_MAP_HEIGHT);

    panel.begin();
    fb = (uint16_t *)ps_malloc(W * H * sizeof(uint16_t));
    if (!fb) { Serial.println("ps_malloc failed"); return; }

    drawEye((IRIS_MIN + IRIS_MAX) / 2, (SCLERA_SIZE - S) / 2, (SCLERA_SIZE - S) / 2, 0, 0);
    panel.pushColors(0, 0, W, H, fb);          // END coords — full frame
    panel.setBrightness(16);                   // after drawing (G21)
}

void loop() {
    static uint32_t totalFrames = 0, frames = 0, renderUs = 0, pushUs = 0, lastReport = millis();

    // Pupil breathes between IRIS_MIN and IRIS_MAX every ~4 s.
    float phase = (millis() % 4000) / 4000.0f;                     // 0..1
    int iScale = IRIS_MIN + (IRIS_MAX - IRIS_MIN) * (0.5f - 0.5f * cosf(phase * 2 * PI));
    const int c = (SCLERA_SIZE - S) / 2;

    uint32_t t0 = micros();
    drawEye(iScale, c, c, 0, 0);
    uint32_t t1 = micros();
    panel.pushColors(0, 0, W, H, fb);
    uint32_t t2 = micros();

    frames++;
    renderUs += t1 - t0;
    pushUs += t2 - t1;
    if (millis() - lastReport >= 2000) {
        totalFrames += frames;
        logf("t=%3lus  frames %lu  %.1f fps  render+double %lu us  push %lu us  (iScale %d)\n",
             millis() / 1000, (unsigned long)totalFrames,
             frames * 1000.0f / (millis() - lastReport),
             (unsigned long)(renderUs / frames), (unsigned long)(pushUs / frames), iScale);
        frames = renderUs = pushUs = 0;
        lastReport = millis();
    }
}
